## drivers/clocksource/Kconfig.rej
```kconfig
diff a/drivers/clocksource/Kconfig b/drivers/clocksource/Kconfig	(rejected hunks)
@@ -158,6 +158,14 @@ config ARM_ARCH_TIMER_EVTSTREAM
 	  This must be disabled for hardware validation purposes to detect any
 	  hardware anomalies of missing events.
 
+config ARM_ARCH_TIMER_VCT_ACCESS
+	bool "Support for ARM architected timer virtual counter access in userspace"
+	default !ARM64
+	depends on ARM_ARCH_TIMER
+	help
+	  This option enables support for reading the ARM architected timer's
+	  virtual counter in userspace.
+
 config MSM_TIMER_LEAP
         bool "ARCH TIMER counter rollover"
         default n
```

## drivers/input/Kconfig.rej
```kconfig
diff a/drivers/input/Kconfig b/drivers/input/Kconfig	(rejected hunks)
@@ -216,6 +216,8 @@ source "drivers/input/misc/Kconfig"
 
 source "drivers/input/sensors/bmi160/Kconfig"
 
+source "drivers/input/fingerprint/Kconfig"
+
 endif
 
 menu "Hardware I/O ports"
```

## drivers/leds/Kconfig.rej
```kconfig
diff a/drivers/leds/Kconfig b/drivers/leds/Kconfig	(rejected hunks)
@@ -641,6 +641,13 @@ config LEDS_VERSATILE
 	help
 	  This option enabled support for the LEDs on the ARM Versatile
 	  and RealView boards. Say Y to enabled these.
+	  
+config LEDS_AW2015
+	tristate "LED Support for AW2015"
+	depends on LEDS_CLASS && I2C
+	help
+		this option enables support for the AW2015 RGB LED connected
+		through I2C. Say Y to enable support for the AW2015 LED
 
 config LEDS_QPNP_HAPTICS
 	tristate "Haptics support for QPNP PMIC"
```

## drivers/power/Kconfig.rej
```kconfig
diff a/drivers/power/Kconfig b/drivers/power/Kconfig	(rejected hunks)
@@ -442,6 +442,12 @@ config CHARGER_BQ25890
 	help
 	  Say Y to enable support for the TI BQ25890 battery charger.
 
+config CHARGER_BQ25600_SLAVE
+	tristate "TI BQ25600 battery charger slave driver"
+	depends on I2C
+	help
+	  Say Y to enable support for the TI BQ25600 battery charger.
+
 config CHARGER_SMB347
 	tristate "Summit Microelectronics SMB347 Battery Charger"
 	depends on I2C
@@ -521,6 +527,18 @@ config AXP20X_POWER
 	  This driver provides support for the power supply features of
 	  AXP20x PMIC.
 
+config WIRELESS_CHARGER_STWLC33
+	bool "ST STWLC33 Wireless Charging control Driver"
+	depends on I2C
+	help
+	  ST STWLC33 wireless charging control driver
+
+config WIRELESS_CHARGER_P9221
+	bool "IDT P9221 Wireless Charging control Driver"
+	depends on I2C
+	help
+	  IDT P9221 wireless charging control driver
+
 source "drivers/power/reset/Kconfig"
 source "drivers/power/supply/Kconfig"
 
```

## drivers/video/fbdev/msm/Kconfig.rej
```kconfig
diff a/drivers/video/fbdev/msm/Kconfig b/drivers/video/fbdev/msm/Kconfig	(rejected hunks)
@@ -1,5 +1,8 @@
 source "drivers/video/fbdev/msm/msm_dba/Kconfig"
 
+# SW4-HL-Display-GlanceMode-00+_20170524
+source "drivers/video/fbdev/msm/fih/Kconfig"
+
 if FB_MSM
 
 config FB_MSM_MDSS_COMMON
@@ -122,4 +125,9 @@ config FB_MSM_MDSS_XLOG_DEBUG
 	driver during fatal errors and enable some display-driver logging
 	into an internal buffer (this avoids logging overhead).
 
+config PXLW_IRIS3
+	depends on FB_MSM_MDSS
+	bool "Enable pxlw iris3"
+	default y
+
 endif
```
